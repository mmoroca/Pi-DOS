## br2-external/Config.in
```kconfig
menu "Pi-DOS"
source "$BR2_EXTERNAL_PI_DOS_PATH/package/pi-dos-init/Config.in"
source "$BR2_EXTERNAL_PI_DOS_PATH/package/pi-dos-runtime/Config.in"
endmenu
```

## br2-external/package/armdos-init/Config.in
```kconfig
config BR2_PACKAGE_ARMDOS_INIT
	bool "armdos-init"
	depends on BR2_USE_MMU
	depends on BR2_ENABLE_LOCALE && BR2_USE_WCHAR
	depends on BR2_TOOLCHAIN_GCC_AT_LEAST_5
	select BR2_PACKAGE_UTIL_LINUX
	select BR2_PACKAGE_UTIL_LINUX_LIBFDISK
	select BR2_PACKAGE_PARTED
	select BR2_PACKAGE_DOSFSTOOLS
	select BR2_PACKAGE_DOSFSTOOLS_FSCK_FAT
	help
	  Root PID 1 supervisor for the Pi-DOS appliance.
```

## br2-external/package/armdos-runtime/Config.in
```kconfig
config BR2_PACKAGE_ARMDOS_RUNTIME
	bool "armdos-runtime"
	depends on BR2_INSTALL_LIBSTDCPP
	depends on BR2_TOOLCHAIN_HAS_THREADS
	depends on !BR2_STATIC_LIBS
	depends on BR2_PACKAGE_SDL2
	depends on BR2_PACKAGE_ALSA_LIB
	select BR2_PACKAGE_ZLIB
	select BR2_PACKAGE_LIBPNG
	select BR2_PACKAGE_ALSA_LIB_SEQ
	help
	  Pinned DOSBox-X-derived SDL2 runtime with Pi-DOS patches.
```

## br2-external/package/pi-dos-init/Config.in
```kconfig
config BR2_PACKAGE_PI_DOS_INIT
	bool "pi-dos-init"
	depends on BR2_USE_MMU
	depends on BR2_ENABLE_LOCALE && BR2_USE_WCHAR
	depends on BR2_TOOLCHAIN_GCC_AT_LEAST_5
	select BR2_PACKAGE_UTIL_LINUX
	select BR2_PACKAGE_UTIL_LINUX_LIBFDISK
	select BR2_PACKAGE_PARTED
	select BR2_PACKAGE_DOSFSTOOLS
	select BR2_PACKAGE_DOSFSTOOLS_FSCK_FAT
	select BR2_PACKAGE_DHCPCD
	select BR2_PACKAGE_CHRONY
	select BR2_TARGET_TZ_INFO
	help
	  Root PID 1 supervisor for the Pi-DOS appliance.
```

## br2-external/package/pi-dos-runtime/Config.in
```kconfig
config BR2_PACKAGE_PI_DOS_RUNTIME
	bool "pi-dos-runtime"
	depends on BR2_INSTALL_LIBSTDCPP
	depends on BR2_TOOLCHAIN_HAS_THREADS
	depends on BR2_USE_WCHAR
	depends on !BR2_STATIC_LIBS
	depends on BR2_PACKAGE_SDL2
	depends on BR2_PACKAGE_ALSA_LIB
	depends on BR2_PACKAGE_FLUIDSYNTH
	select BR2_PACKAGE_ZLIB
	select BR2_PACKAGE_LIBPNG
	select BR2_PACKAGE_UTIL_LINUX
	select BR2_PACKAGE_UTIL_LINUX_LIBBLKID
	select BR2_PACKAGE_DOSFSTOOLS
	select BR2_PACKAGE_DOSFSTOOLS_FATLABEL
	select BR2_PACKAGE_EXFATPROGS
	select BR2_PACKAGE_SDL2_NET
	select BR2_PACKAGE_SLIRP
	select BR2_PACKAGE_LIBPCAP
	select BR2_TOOLCHAIN_GLIBC_GCONV_LIBS_COPY if BR2_TOOLCHAIN_USES_GLIBC
	select BR2_PACKAGE_ALSA_LIB_SEQ
	help
	  Pinned DOSBox-X-derived SDL2 runtime with Pi-DOS patches.
```
